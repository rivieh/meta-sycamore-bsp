## recipes-bsp/u-boot/files/Kconfig
```kconfig
if TARGET_IMX8MN_550P2_REV2

config SYS_BOARD
	default "imx8mn-550p2-rev2"

config SYS_VENDOR
	default "rivieh"

config SYS_CONFIG_NAME
	default "imx8mn-550p2-rev2"

config IMX8MN_LOW_DRIVE_MODE
	bool "Enable the low drive mode of iMX8MN on EVK board"
	default n

source "board/freescale/common/Kconfig"

endif
```
